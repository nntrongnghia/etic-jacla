## sdkconfig.defaults
```kconfig
CONFIG_ESPTOOLPY_FLASHFREQ_80M=y
CONFIG_ESPTOOLPY_FLASHMODE_QIO=y

CONFIG_SPIRAM_SPEED_80M=y

CONFIG_ESPTOOLPY_FLASHSIZE_8MB=y
CONFIG_ESPTOOLPY_FLASHSIZE="8MB"

CONFIG_PARTITION_TABLE_CUSTOM=y
CONFIG_PARTITION_TABLE_CUSTOM_FILENAME="partitions.csv"
CONFIG_PARTITION_TABLE_FILENAME="partitions.csv"

CONFIG_NEWLIB_TIME_SYSCALL_USE_RTC=y
RTC_CLK_SRC_INT_RC=y
```

## test/camera_stream/main/Kconfig.projbuild
```kconfig
menu "Main configuration"

  menu "Wifi Configuration"
    config WIFI_SSID
      string "Wifi SSID"
      default "Gaëtan Wi-Fi"
    config WIFI_PASSWORD
      string "Wifi password"
      default "00000000"
  endmenu

  menu "Camera configuration"

    config XCLK_FREQ
      int "XCLK Frequency"
      default "10000000"
      help
        The XCLK Frequency in Herz.
    
    config ESP32_SPIRAM_SUPPORT
      bool "PSRAM support"
      default n
      help
        PSRAM support for camera

menu "Pin Configuration"
      config D0
        int "D0"
        default "13"
      config D1
        int "D1"
        default "16"
      config D2
        int "D2"
        default "12"
      config D3
        int "D3"
        default "15"
      config D4
        int "D4"
        default "11"
      config D5
        int "D5"
        default "7"
      config D6
        int "D6"
        default "10"
      config D7
        int "D7"
        default "6"
      config XCLK
        int "XCLK"
        default "9"
      config PCLK
        int "PCLK"
        default "5"
      config VSYNC
        int "VSYNC"
        default "4"
      config HREF
        int "HREF"
        default "46"
      config SDA
        int "SDA"
        default "18"
      config SCL
        int "SCL"
        default "14"
      config RESET
        int "RESET"
        default "-1"
      config PWDN
        int "PWDN"
        default "-1"
    endmenu

    config OV2640_SUPPORT
      bool "OV2640 Support"
      default y
      help
        Enable this option if you want to use the OV2640.
        Disable this option to save memory.

    config OV7725_SUPPORT
      bool "OV7725 Support"
      default n
      help
        Enable this option if you want to use the OV7725.
        Disable this option to save memory.

    config OV3660_SUPPORT
      bool "OV3660 Support"
      default n
      help
        Enable this option if you want to use the OV3360.
        Disable this option to save memory.

    config OV5640_SUPPORT
      bool "OV5640 Support"
      default n
      help
        Enable this option if you want to use the OV5640.
        Disable this option to save memory.

    choice CAMERA_TASK_PINNED_TO_CORE
      bool "Camera task pinned to core"
      default CAMERA_CORE0
      help
        Pin the camera handle task to a certain core(0/1). It can also be done automatically choosing NO_AFFINITY.

      config CAMERA_CORE0
        bool "CORE0"
      config CAMERA_CORE1
        bool "CORE1"
      config CAMERA_NO_AFFINITY
        bool "NO_AFFINITY"

    endchoice

  endmenu
	
endmenu
```

## test/code_scanner/main/Kconfig.projbuild
```kconfig
menu "QR decoding"

  config AES_KEY
    string "AES Decryption Key"
    default ""
	
endmenu
```

## test/code_scanner/sdkconfig.defaults.esp32s3
```kconfig
CONFIG_ESP32S3_DEFAULT_CPU_FREQ_240=y
CONFIG_ESP32S3_SPIRAM_SUPPORT=y

CONFIG_ESP32S3_DATA_CACHE_64KB=y
CONFIG_ESP32S3_DATA_CACHE_8WAYS=y
CONFIG_ESP32S3_DATA_CACHE_LINE_64B=y

CONFIG_CAMERA_MODULE_ESP_S3_EYE=n
CONFIG_LCD_DRIVER_SCREEN_CONTROLLER_ST7789=n
CONFIG_ESPTOOLPY_NO_STUB=n
CONFIG_ESP_CONSOLE_USB_SERIAL_JTAG=n

CONFIG_SPIRAM_IGNORE_NOTFOUND=y
CONFIG_SPIRAM_MODE_OCT=y
```

## test/light_detection/main/Kconfig.projbuild
```kconfig
menu "Color14 Pin Configuration"
    config COLOR14_SDA
        int "COLOR14_SDA"
        default "1"
    config COLOR14_SCL
        int "COLOR14_SCL"
        default "2"
    config COLOR14_INT
        int "COLOR14_INT"
        default "42"
endmenu
```
